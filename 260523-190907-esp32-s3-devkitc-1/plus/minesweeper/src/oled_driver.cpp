/*
 * oled_driver.cpp — OLED SSD1306 驱动模块 (128×64 / I2C / 颜文字 + 全屏角色)
 * ============================================================================
 * 【核心知识点】
 *
 * 1. 颜文字(kaomoji)表情：14 个表情用 UTF-8 字符串表示，
 *    如 "(^_^)" "(>_<)"，通过 U8g2 的 drawUTF8 直接渲染，
 *    不再使用 16×16 位图。
 *
 * 2. 全屏角色仍使用 XBM 位图 + showFullImage() 转换显示。
 *
 * 3. U8g2 缓冲区格式：SSD1306 有 8 页，每页 128 字节。
 *
 * 【修改颜文字的方法】
 *   直接修改 faceKaomoji[] 数组中的字符串即可。
 *   字符串支持 ASCII 和 CJK 字符（由 wqy 字体渲染）。
 */

#include "oled_driver.h"
#include <Wire.h>
#include <SPI.h>

// ── 全局 U8g2 对象 ────────────────────────────────────────────
// U8G2_SSD1306_128X64_NONAME_F_HW_I2C 展开含义:
//   SSD1306 驱动芯片 / 128×64 分辨率 / 通用模块
//   F = 全帧缓冲(1024字节RAM) / HW_I2C = 硬件I2C
// U8G2_R0 = 不旋转 / U8X8_PIN_NONE = 无额外控制引脚
static U8G2_SSD1306_128X64_NONAME_F_HW_I2C u8g2_oled(U8G2_R0, U8X8_PIN_NONE);

// ═══════════════════════════════════════════════════════════════
//  颜文字表情 (14个 UTF-8 字符串, 12px 字体渲染)
// ═══════════════════════════════════════════════════════════════
// 通过更换字符串即可改变表情, 每个约 5-8 个字符宽 (~60-96px)
// 显示位置: 水平居中于 OLED 128×64 区域

// 0: FACE_PIANO_1 — 默认(睁眼+微笑)
static const char kaomoji_0[] = "(o_o)";

// ═══════════════════════════════════════════════════════════════
//  全屏角色图像 (128×64 XBM, 每个1024字节)
// ═══════════════════════════════════════════════════════════════
// 通过按键组合触发，钢琴游戏中：
//   左一键      → phanion
//   左二键      → phanion2
//   左一+左二   → phanion3 (合体)
//   右一键      → mydei1
//   右二键      → mydei2
//   右一+右二   → mydei3 (合体)
//   左右同时    → conflict (融合)

static const uint8_t PROGMEM image_phanion[] = {
  0xff,0xff,0xff,0xff,0xff,0xff,0xff,0xff,0xff,0xff,0xff,0xff,0xff,0xff,0xff,0xff,
  0xff,0xff,0xff,0xff,0xff,0xff,0xff,0xff,0xff,0xff,0xff,0xff,0xff,0xff,0xff,0xff,
  0xff,0xff,0xff,0xff,0xff,0xff,0xff,0xff,0xff,0xff,0xff,0xff,0xff,0xff,0xff,0xff,
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  0xff,0xff,0xff,0xff,0xff,0xff,0xff,0xff,0xff,0xff,0xe0,0x2f,0xff,0xff,0xff,0xff,
};

static const uint8_t PROGMEM image_phanion2[] = {
  0xff,0xff,0xff,0xff,0xff,0xff,0xff,0xff,0xff,0xff,0xff,0xff,0xff,0xff,0xff,0xff,
  0xff,0xff,0xff,0xff,0xff,0xff,0xff,0xff,0xff,0xff,0xff,0xff,0xff,0xff,0xff,0xff,
  0xff,0xff,0xff,0xff,0xff,0xff,0xff,0xff,0xff,0xff,0xff,0xff,0xff,0xff,0xff,0xff,
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  0xff,0xff,0xff,0xff,0xff,0xff,0xff,0xff,0xff,0xff,0xff,0xff,0xff,0xff,0xff,0xff,
};

static const uint8_t PROGMEM image_phanion3[] = {
  0xff,0xff,0xff,0xff,0xff,0xff,0xff,0xff,0xff,0xff,0xff,0xff,0xff,0xff,0xff,0xff,
  0xff,0xff,0xff,0xff,0xff,0xff,0xff,0xff,0xff,0xff,0xff,0xff,0xff,0xff,0xff,0xff,
  0xff,0xff,0xff,0xff,0xff,0xff,0xff,0xff,0xff,0xff,0xff,0xff,0xff,0xff,0xff,0xff,
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  0xff,0xff,0xff,0xff,0xff,0xff,0xff,0xff,0xff,0xff,0xff,0xff,0xff,0xff,0xff,0xff,
};

static const uint8_t PROGMEM image_mydei1[] = {
  0xff,0xff,0xff,0xff,0xff,0xff,0xff,0xff,0xff,0xff,0xff,0xff,0xff,0xff,0xff,0xff,
  0xff,0xff,0xff,0xff,0xff,0xff,0xff,0xff,0xff,0xff,0xff,0xff,0xff,0xff,0xff,0xff,
  0xff,0xff,0xff,0xff,0xff,0xff,0xff,0xff,0xff,0xff,0xff,0xff,0xff,0xff,0xff,0xff,
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  0xff,0xff,0xff,0xff,0xff,0xff,0xff,0xff,0xff,0xff,0xf0,0x0f,0xff,0xff,0xff,0xff,
};

static const uint8_t PROGMEM image_mydei2[] = {
  0xff,0xff,0xff,0xff,0xff,0xff,0xff,0xff,0xff,0xff,0xff,0xff,0xff,0xff,0xff,0xff,
  0xff,0xff,0xff,0xff,0xff,0xff,0xff,0xff,0xff,0xff,0xff,0xff,0xff,0xff,0xff,0xff,
  0xff,0xff,0xff,0xff,0xff,0xff,0xf8,0x7f,0xff,0xff,0xff,0xff,0xff,0xff,0xff,0xff,
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  0xff,0xff,0xff,0xff,0xff,0xff,0xff,0xff,0xff,0xff,0xff,0xff,0xff,0xff,0xff,0xff,
};

static const uint8_t PROGMEM image_mydei3[] = {
  0xff,0xff,0xff,0xff,0xff,0xff,0xff,0xff,0xff,0xff,0xff,0xff,0xff,0xff,0xff,0xff,
  0xff,0xff,0xff,0xff,0xff,0xff,0xff,0xff,0xff,0xff,0xff,0xff,0xff,0xff,0xff,0xff,
  0xff,0xff,0xff,0xff,0xff,0xff,0xff,0xff,0xff,0xff,0xff,0xff,0xff,0xff,0xff,0xff,
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  0xff,0xff,0xff,0xff,0xff,0xff,0xff,0xff,0xff,0xff,0xff,0xff,0xff,0xff,0xff,0xff,
};

// 左右键同时按下时的融合角色
static const uint8_t PROGMEM image_conflict[] = {
  0x00,0x00,0x00,0x00,0x00,0x00,0x00,0x03,0xE0,0x00,0x00,0x00,0x00,0x00,0x00,0x00,
  0x00,0x00,0x00,0x00,0x00,0x00,0x00,0x03,0xE0,0x00,0x00,0x00,0x00,0x00,0x00,0x00,
  0x00,0x00,0x00,0x00,0x00,0x00,0x00,0x03,0xE0,0x00,0x00,0x00,0x00,0x00,0x00,0x00,
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  0x00,0x00,0x00,0x00,0x00,0x00,0x00,0x00,0x00,0x00,0x00,0x00,0x00,0x00,0x00,0x00
};

// ═══════════════════════════════════════════════════════════════
//  更多颜文字表情 (face_1 到 face_13)
// ═══════════════════════════════════════════════════════════════
// 【修改方法】直接改下面字符串即可，支持 ASCII + 中文（wqy 字体）

// 1: FACE_PIANO_2 — 眨眼
static const char kaomoji_1[] = "(^-^)";
// 2: FACE_PIANO_4 — 惊讶
static const char kaomoji_2[] = "(O_O)";
// 3: FACE_PIANO_5 — 酷
static const char kaomoji_3[] = "(-_-)";
// 4: FACE_PIANO_COMBO — 开心 combo≥10
static const char kaomoji_4[] = "(*^_^*)";
// 5: FACE_PIANO_MISS — 失误
static const char kaomoji_5[] = "(>_<)";
// 6: FACE_STUDY_A — 专注睁眼
static const char kaomoji_6[] = "(._.)";
// 7: FACE_STUDY_B — 专注闭眼
static const char kaomoji_7[] = "(-_-)zz";
// 8: FACE_PAUSE_A — 暂停睁眼
static const char kaomoji_8[] = "(o_o;)";
// 9: FACE_PAUSE_B — 暂停闭眼
static const char kaomoji_9[] = "(-_-;)";
// 10: FACE_DONE_A — 完成大笑
static const char kaomoji_10[] = "\\(^o^)/";
// 11: FACE_DONE_B — 完成闭眼笑
static const char kaomoji_11[] = "(^_^)b";
// 12: FACE_IDLE_A — 待机睁眼
static const char kaomoji_12[] = "(^_^)";
// 13: FACE_IDLE_B — 待机闭眼
static const char kaomoji_13[] = "(=_=)";

// ── 颜文字指针数组：通过索引快速获取对应字符串 ────────────────
static const char* const faceKaomoji[FACE_COUNT] = {
  kaomoji_0,  kaomoji_1,  kaomoji_2,  kaomoji_3,  kaomoji_4,  kaomoji_5,  kaomoji_6,
  kaomoji_7,  kaomoji_8,  kaomoji_9,  kaomoji_10, kaomoji_11, kaomoji_12, kaomoji_13
};

// ── 边框文字缓存：oledDrawBorderText 设置，oledShowFace 时显示 ──
static char borderTop[16] = "";
static char borderBottom[16] = "";

// ═══════════════════════════════════════════════════════════════
//  函数实现
// ═══════════════════════════════════════════════════════════════

/*
 * initOLED() - 初始化 OLED 模块 (I2C + U8g2)
 * 1) 启动I2C总线 (SDA=6, SCL=7)
 * 2) 初始化U8g2库
 * 3) 启用UTF-8编码(支持中文)并设置中文字体
 * 4) 清空显示
 */
void initOLED() {
  Wire.begin(OLED_SDA_PIN, OLED_SCL_PIN);      // 启动 I2C
  u8g2_oled.begin();                            // 初始化 SSD1306
  u8g2_oled.enableUTF8Print();                  // 启用 UTF-8 打印(中文支持)
  u8g2_oled.setFont(u8g2_font_wqy12_t_gb2312); // 中文字体: wqy(文泉驿) 12px
  u8g2_oled.clearBuffer();                      // 清空内部缓冲
  u8g2_oled.sendBuffer();                       // 刷新显示
}

void oledClear()            { u8g2_oled.clearBuffer(); }
void oledRefresh()          { u8g2_oled.sendBuffer(); }

// 画 UTF-8 文本, y+12 是 U8g2 的基线偏移习惯
void oledDrawString(int x, int y, const char* str) {
  u8g2_oled.drawUTF8(x, y + 12, str);
}

// 画 XBM 位图 (通用)
void oledDrawBitmap(int x, int y, int w, int h, const uint8_t* bitmap) {
  u8g2_oled.drawXBM(x, y, w, h, bitmap);
}

// 欢迎界面
void oledShowWelcome() {
  oledClear();
  oledDrawString(10, 0,  "Learning Game");
  oledDrawString(25, 18, "ESP32-S3");
  oledDrawString(10, 50, "Press Key");
  oledRefresh();
}

/*
 * oledShowFace(faceType) - 以颜文字(kaomoji)显示表情
 * 在 OLED 上居中绘制对应颜文字字符串 + 边框文字
 * 颜文字约 5-8 字符宽 (~60-96px), 居中于 128px 宽屏幕
 * @param faceType  表情索引 0-13
 */
void oledShowFace(uint8_t faceType) {
  if (faceType >= FACE_COUNT) return;  // 越界保护

  oledClear();

  // 顶部文字
  if (borderTop[0]) {
    oledDrawString(40, 0, borderTop);
  }

  // 底部文字
  if (borderBottom[0]) {
    oledDrawString(40, 52, borderBottom);
  }

  // 获取颜文字字符串
  const char* kao = faceKaomoji[faceType];

  // 计算字符串像素宽度, 居中绘制
  // 12px 中文字体下每个字符约 12px 宽 (西文约 6px)
  // 粗略估算: strlen 数中文字符 + ASCII字符宽度
  int w = u8g2_oled.getStrWidth(kao);
  int x = (128 - w) / 2;   // 水平居中
  if (x < 0) x = 0;

  // 在 OLED 中央 (y≈28) 以大字绘制颜文字
  oledDrawString(x, 28, kao);

  oledRefresh();
}

/*
 * showFullImage(src) - 显示 128×64 全屏 XBM 图像
 *
 * 【核心算法】
 * XBM 数据是"行优先"排列的: 64行 × 每行16字节(128位)
 * U8g2 缓冲是"页优先"排列的: 8页 × 每页128字节
 *
 * 需要做坐标变换:
 *   XBM[row][col_byte].bit[7-(col%8)] → U8g2[page][col].bit[row%8]
 *
 * 详细步骤:
 *   遍历每一页(page 0-7)
 *     遍历每一列(col 0-127)
 *       从 XBM 对应位置取出 8 个垂直像素
 *       合并成 1 字节写入 U8g2 缓冲
 *
 * 颜色反转 ^ 0xFF: 因为 XBM 中 1=黑而 OLED 中 1=亮
 *
 * 带缓存机制: 静态变量保存上一次的源指针,
 * 如果连续显示同一张图就跳过转换(节省大量 CPU 时间)
 *
 * @param src  指向 Flash 中 1024 字节 XBM 数据的指针
 */
void showFullImage(const uint8_t* src) {
  static uint8_t buf[1024];            // 转换后的 U8g2 格式缓冲
  static const uint8_t* cachedSrc = NULL; // 上次转换的源地址

  // 缓存检查: 如果这次要显示的图和上次一样，直接复用缓冲
  if (cachedSrc != src) {
    // 遍历 8 页
    for (int page = 0; page < 8; page++) {
      // 遍历 128 列
      for (int col = 0; col < 128; col++) {
        uint8_t v = 0;  // 这一列 8 个垂直像素的值

        // 遍历该列 8 个垂直像素 (bit 0-7)
        for (int b = 0; b < 8; b++) {
          int py = page * 8 + b;         // 对应的 Y 坐标 (0-63)
          int srcByte = py * 16 + (col >> 3); // XBM 中的字节索引
          int srcBit  = 7 - (col & 7);        // XBM 字节中的位位置
          // 如果 XBM 中该像素为 1
          if (pgm_read_byte(&src[srcByte]) & (1 << srcBit))
            v |= (1 << b);  // 设置 U8g2 缓冲的对应位
        }
        buf[col + page * 128] = v ^ 0xFF; // 存入缓冲 + 颜色反转
      }
    }
    cachedSrc = src;  // 更新缓存标记
  }

  // 将 1024 字节缓冲复制到 U8g2 的内部缓冲
  memcpy(u8g2_oled.getBufferPtr(), buf, 1024);
  u8g2_oled.sendBuffer();  // 发送到 OLED
}

// ── 全屏角色便捷函数 ──────────────────────────────────────────
void oledShowPhanion()   { showFullImage(image_phanion);  }
void oledShowPhanion2()  { showFullImage(image_phanion2); }
void oledShowPhanion3()  { showFullImage(image_phanion3); }
void oledShowMydei1()    { showFullImage(image_mydei1);   }
void oledShowMydei2()    { showFullImage(image_mydei2);   }
void oledShowMydei3()    { showFullImage(image_mydei3);   }
void oledShowConflict()  { showFullImage(image_conflict);  }

/*
 * oledShowBlinkingFace(faceA, faceB, interval) - 眨眼动画
 * 利用 millis() 时间戳在两个表情间循环切换
 *
 * 工作原理:
 *   (millis() / interval) % 2
 *   这个表达式在 interval 毫秒内保持不变，然后翻转
 *   比如 interval=500: 0-499ms→0, 500-999ms→1, 1000-1499ms→0...
 *
 * @param faceA    表情 A (通常睁眼)
 * @param faceB    表情 B (通常闭眼)
 * @param interval 切换间隔(毫秒), 值越小眨眼越快
 */
void oledShowBlinkingFace(uint8_t faceA, uint8_t faceB, uint32_t interval) {
  bool showA = (millis() / interval) % 2 == 0;
  oledShowFace(showA ? faceA : faceB);
}

/*
 * oledShowMenuText(line1, line2, line3) - 显示三行菜单文字
 * 用于在主菜单中显示当前选中模式的描述
 * @param line1-3  文字内容(NULL跳过)
 */
void oledShowMenuText(const char* line1, const char* line2, const char* line3) {
  oledClear();
  if (line1) oledDrawString(5, 0, line1);
  if (line2) oledDrawString(5, 22, line2);
  if (line3) oledDrawString(5, 44, line3);
  oledRefresh();
}

/*
 * oledDrawBorderText(top, bottom) - 设置边框文字缓存
 * 这些文字会在下一次 oledShowFace() 调用时被绘制
 * @param top    顶部文字 (NULL 清除)
 * @param bottom 底部文字 (NULL 清除)
 */
void oledDrawBorderText(const char* top, const char* bottom) {
  if (top) {
    strncpy(borderTop, top, sizeof(borderTop) - 1);
    borderTop[sizeof(borderTop) - 1] = '\0';
  } else {
    borderTop[0] = '\0';
  }
  if (bottom) {
    strncpy(borderBottom, bottom, sizeof(borderBottom) - 1);
    borderBottom[sizeof(borderBottom) - 1] = '\0';
  } else {
    borderBottom[0] = '\0';
  }
}

void oledShowScore(int score) {
  oledClear();
  char buf[32];
  snprintf(buf, sizeof(buf), "Score: %d", score);
  oledDrawString(30, 25, buf);
  oledRefresh();
}

U8G2* getOLED() { return &u8g2_oled; }
